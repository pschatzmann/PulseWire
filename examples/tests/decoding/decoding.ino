
#include "Codecs.h"

int baud = 100;
ManchesterPreamble preamble;
ManchesterCodec codec(preamble);

const int edges[][2] = {
    {0, 45742}, {1, 5027}, {0, 5054},  {1, 5035},  {0, 5023},  {1, 5022},
    {0, 5023},  {1, 5008}, {0, 5008},  {1, 5022},  {0, 5022},  {1, 5007},
    {0, 5007},  {1, 5008}, {0, 5008},  {1, 5007},  {0, 5032},  {1, 5027},
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    {0, 10008}, {1, 5007}, {0, 5007}};

void setup() {
  Serial.begin(115200);
  Logger::setLogLevel(Logger::LOG_LEVEL_INFO);
}

void loop() {
  Serial.print("Decoding test: baud=");
  Serial.println(baud);

  codec.begin(baud);
  Serial.print("Decoded byte:");
  for (const auto& edge : edges) {
    uint8_t result;
    if (codec.decodeEdge(edge[1], edge[0], result)) {
      Serial.print("0x");
      Serial.print(result, HEX);
      Serial.print(" ");
    }
  }
  Serial.println();
  
  while (true) delay(1000);
}
